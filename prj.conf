## CMakeLists.txt
```
cmake_minimum_required(VERSION 3.21.0)
set(CMAKE_EXPORT_COMPILE_COMMANDS ON)

find_package(Zephyr REQUIRED HINTS $ENV{ZEPHYR_BASE})

project(pi_pico)

set(SOURCE_DIR "${PROJECT_SOURCE_DIR}/src")

FILE(GLOB app_sources ${SOURCE_DIR}/*.c )

target_include_directories(app PRIVATE ${SOURCE_DIR})
target_sources(app PRIVATE ${app_sources})

add_subdirectory(drivers/leds/hearbit)

SET(CMAKE_CXX_FLAGS  "${CMAKE_CXX_FLAGS} -std=gnu2x")

zephyr_library_include_directories(.)
```

## prj.conf
```kconfig
CONFIG_CONSOLE=y
CONFIG_UART_CONSOLE=y
CONFIG_LOG=y
CONFIG_UART_INTERRUPT_DRIVEN=y
CONFIG_LOG_MODE_DEFERRED=y
CONFIG_LOG_MODE_IMMEDIATE=y
CONFIG_GPIO=y
```

## app.overlay
```dts
/ {
    aliases {
        heartbit0 = &heartbit0;
    };

    heartbit0: heartbit_node {
        status = "okay";
        compatible = "custom,heartbit";
        on_time = <100>;
        off_time = <900>;
        gpios = <&gpio0 25 GPIO_ACTIVE_HIGH>;
    };

    leds {
        status = "disabled";
    };
};
```

## dts/bindings/leds/custom,heartbit.yaml
```yaml
description: |
    Heartbit driver

compatible: "custom,heartbit"
properties:
  on_time:
    type: int
    required: true
  off_time:
    type: int
    required: true
  gpios:
    type: phandle-array
    required: true
```

## src/main.c
```c
#include <stdio.h>
#include <zephyr/kernel.h>
#include <zephyr/drivers/gpio.h>
#include <zephyr/drivers/led.h>

/* 1000 msec = 1 sec */
#define SLEEP_TIME_MS 1000

/* The devicetree node identifier for the "led0" alias. */
#define LED0_NODE DT_ALIAS(led0)

/*
 * A build error on this line means your board is unsupported.
 * See the sample documentation for information on how to fix this.
 */
static const struct gpio_dt_spec led = GPIO_DT_SPEC_GET(LED0_NODE, gpios);
// static const struct device *const heartbit_dev = DEVICE_DT_GET(DT_ALIAS(heartbit0));
static const struct device *const heartbit_dev = DEVICE_DT_GET(DT_NODELABEL(heartbit0));

int main(void) {
    int  ret;
    bool led_state = true;

    if (!gpio_is_ready_dt(&led)) {
        return 0;
    }

    ret = gpio_pin_configure_dt(&led, GPIO_OUTPUT_ACTIVE);
    if (ret < 0) {
        return 0;
    }

    led_on(heartbit_dev, 0);

    while (1) {
        ret = gpio_pin_toggle_dt(&led);
        if (ret < 0) {
            return 0;
        }

        led_state = !led_state;
        printf("LED state: %s\n", led_state ? "ON" : "OFF");
        k_msleep(SLEEP_TIME_MS);
    }
    return 0;
}
```
